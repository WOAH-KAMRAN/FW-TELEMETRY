#include <SPI.h>
#include <nRF24L01.h>
#include <RF24.h>
#include <Wire.h>
#include <Adafruit_GFX.h>
#include <Adafruit_SSD1306.h>
#include <SoftwareSerial.h>

// NRF24 Setup
RF24 radio(9, 10);  // CE, CSN
const byte address[6] = "fsam1";

// OLED Setup
#define SCREEN_WIDTH 128
#define SCREEN_HEIGHT 64
#define OLED_RESET -1
Adafruit_SSD1306 display(SCREEN_WIDTH, SCREEN_HEIGHT, &Wire, OLED_RESET);

// Bluetooth on D3 (RX), D4 (TX)
SoftwareSerial BT(3, 4);

// Telemetry struct
struct TelemetryData {
  uint16_t packetID;
  float voltage;
  float latitude;
  float longitude;
};
#define LOGO_WIDTH 32
#define LOGO_HEIGHT 32
const unsigned char aero_logo_bits[]PROGMEM ={
  0xff, 0xff, 0xff, 0xff, 0xff, 0xff, 0xff, 0xff, 0xff, 0xff, 0xff, 0xff, 0xff, 0xff, 0xff, 0xff, 
  0xff, 0xff, 0xff, 0xff, 0xff, 0xff, 0xff, 0xff, 0xff, 0xff, 0xff, 0xff, 0xff, 0xff, 0xff, 0xff, 
  0xff, 0xff, 0xff, 0xff, 0xff, 0xff, 0xff, 0xff, 0xff, 0xff, 0xff, 0xff, 0xff, 0xff, 0xff, 0xff, 
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  0xff, 0xff, 0xff, 0xff, 0xff, 0xff, 0xff, 0xff, 0xff, 0xff, 0xff, 0xf7, 0xff, 0xff, 0xff, 0xff

};

TelemetryData incomingData;
uint16_t lastPacketID = 0;
int packetsReceived = 0;
int packetsLost = 0;
unsigned long lastReset = 0;
int rssi = 100;

void setup() {
  Serial.begin(9600);
  BT.begin(9600);

  // OLED Init
  if (!display.begin(SSD1306_SWITCHCAPVCC, 0x3C)) {
    while (true);
  }
  
  display.clearDisplay();
  display.drawBitmap(0, 0, aero_logo_bits , 128, 64, WHITE);
   display.display();
  delay(2500);
 display.clearDisplay();
  display.setTextColor(SSD1306_WHITE);
  display.setTextSize(2);
  display.setCursor(20, 10);
  display.print("ASTRA V1");
  display.setTextSize(1);
  display.setCursor(5, 40);
  display.print("Aerostars Telemetry");
  display.setCursor(5, 50);
  display.print("&Realtime Assistance");
  display.display();
  delay(2500);
  display.clearDisplay();

  // NRF24 Init
  radio.begin();
  radio.openReadingPipe(0, address);
  radio.setPALevel(RF24_PA_LOW);
  radio.startListening();
}

void loop() {
  if (radio.available()) {
    radio.read(&incomingData, sizeof(incomingData));
    updateRSSI(incomingData.packetID);
    updateDisplay();
    sendBluetoothData();
  }
}

void updateRSSI(uint16_t currentID) {
  if (currentID > lastPacketID) {
    int lost = currentID - lastPacketID - 1;
    if (lost < 0) lost = 0;
    packetsLost += lost;
    packetsReceived++;
    lastPacketID = currentID;
  }

  if (millis() - lastReset > 5000) {
    float deliveryRatio = (float)packetsReceived / (packetsReceived + packetsLost + 1);
    rssi = map(deliveryRatio * 100, 0, 100, 0, 100);
    packetsReceived = 0;
    packetsLost = 0;
    lastReset = millis();
  }
}
void drawSignalBars(int level) {
  int baseX = 100;
  int baseY = 10;
  int barWidth = 4;
  for (int i = 0; i < 4; i++) {
    int height = (i + 1) * 3;
    if (i < level) {
      display.fillRect(baseX + i * (barWidth + 2), baseY - height, barWidth, height, SSD1306_WHITE);
    } else {
      display.drawRect(baseX + i * (barWidth + 2), baseY - height, barWidth, height, SSD1306_WHITE);
    }
  }
}

void drawBatteryIcon(float voltage) {
  int x = 100, y = 40;
  int level = map(voltage * 10, 105, 126, 0, 5);
  if (level < 0) level = 0;
  if (level > 5) level = 5;

  display.drawRect(x, y, 14, 6, SSD1306_WHITE);
  display.fillRect(x + 14, y + 2, 2, 2, SSD1306_WHITE);

  for (int i = 0; i < level; i++) {
    display.fillRect(x + 2 + i * 2, y + 1, 1, 4, SSD1306_WHITE);
  }
}


void updateDisplay() {
  display.clearDisplay();

  display.setTextSize(1);
  display.setCursor(0, 0);
  display.print("ASTRA v1");

  

  display.setCursor(0, 16);
  display.print("Batt: ");
  display.print(incomingData.voltage, 1);
  display.print("V");

  display.setCursor(0, 26);
  display.print("RSSI: ");
  display.print(rssi);
  display.print("%");

  display.setCursor(0, 36);
  display.print("Lat: ");
  display.print(incomingData.latitude, 4);

  display.setCursor(0, 46);
  display.print("Lon: ");
  display.print(incomingData.longitude, 4);

  display.setCursor(0, 56);
  if (incomingData.voltage < 10.5) {
    display.print("!! LOW BATTERY !!");
  } else if (rssi < 40) {
    display.print("!! WEAK SIGNAL !!");
  }
int bars = map(rssi, 0, 100, 0, 4);
  drawSignalBars(bars);
  drawBatteryIcon(incomingData.voltage);

  display.display();

  
}

void sendBluetoothData() {
  BT.print("Batt:");
  BT.print(incomingData.voltage, 1);
  BT.print(",Rssi:");
  BT.print(rssi);
  BT.print(incomingData.latitude, 4);
  BT.print(incomingData.longitude, 4);
  BT.println();
}
