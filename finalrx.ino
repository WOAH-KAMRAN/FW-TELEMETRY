#include <SPI.h>
#include <nRF24L01.h>
#include <RF24.h>
#include <Adafruit_GFX.h>
#include <Adafruit_SSD1306.h>

#define OLED_RESET -1
Adafruit_SSD1306 display(128, 64, &Wire, OLED_RESET);

// NRF24L01 Setup
RF24 radio(9, 10);  // CE, CSN
const byte address[6] = "fsam1";

// Button pin (to toggle GPS display)
#define BUTTON_PIN 2

// Timing variables for signal detection
unsigned long lastSignalTime = 0;
const unsigned long signalTimeout = 3000; // 3 seconds with no packet -> signal lost

// Variables for telemetry display
float voltage = 0.0;
int rssi = 0;            // This value can come from a packet or be simulated using packet loss
char gpsData[32] = "";   // GPS info as a string

// For packet-loss based RSSI simulation (optional simple method)
unsigned long lastRSSICheck = 0;
int packetsReceived = 0;
const int expectedPacketsPerSecond = 10; // Adjust if TX sends more or less often
int rssiPercent = 100;  // Calculated pseudo-RSSI

// Telemetry data received (if using structured data instead of a string, modify accordingly)
// For this example, we'll assume that TX sends a formatted string
// e.g.: "V:11.5,R:80,G:28.7041,77.1025"
char receivedPacket[64] = {0};

// Flag for GPS coordinate display (toggled by the button)
bool showCoordinates = false;

// --- Aerostars Logo Placeholder ---
// Replace this array with your actual Aerostars logo bitmap data if available.
const unsigned char aerostars_logo [] PROGMEM = {
  0xff, 0xff, 0xff, 0xff, 0xff, 0xff, 0xff, 0xff, 0xff, 0xff, 0xff, 0xff, 0xff, 0xff, 0xff, 0xff, 
  0xff, 0xff, 0xff, 0xff, 0xff, 0xff, 0xff, 0xff, 0xff, 0xff, 0xff, 0xff, 0xff, 0xff, 0xff, 0xff, 
  0xff, 0xff, 0xff, 0xff, 0xff, 0xff, 0xff, 0xff, 0xff, 0xff, 0xff, 0xff, 0xff, 0xff, 0xff, 0xff, 
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  0xff, 0xff, 0xff, 0xff, 0xff, 0xff, 0xff, 0xff, 0xff, 0xff, 0xff, 0xf7, 0xff, 0xff, 0xff, 0xff
};

//---------------------------------------------------------------
// Function to show the Aerostars logo for 2 seconds
void drawLogo() {
  display.clearDisplay();
  display.drawBitmap(0, 0, aerostars_logo, 128, 64, WHITE);
  display.display();
  delay(5000);
}

//---------------------------------------------------------------
// Function to show the ASTRA splash screen for 2.5 seconds
void drawASTRASplash() {
  display.clearDisplay();
  display.setTextSize(2);
  display.setTextColor(WHITE);
  display.setCursor(20, 10);
  display.println("ASTRA");
  display.setTextSize(1);
  display.setCursor(5, 40);
  display.println("Aerostars Telemetry &");
  display.setCursor(5, 50);
  display.println("Real-time Assistant");
  display.display();
  delay(2500);
  display.clearDisplay();
}

//---------------------------------------------------------------
// Function to show the "Searching for Signal" screen
void drawSearching() {
  display.clearDisplay();
  display.setTextSize(1);
  display.setTextColor(WHITE);
  display.setCursor(15, 20);
  display.println("Searching Signal..");
  display.setCursor(20, 40);
  display.println("Please turn on TX");
  display.display();
}

//---------------------------------------------------------------
// Setup function
void setup() {
  pinMode(BUTTON_PIN, INPUT_PULLUP);
  Serial.begin(9600);
  display.begin(SSD1306_SWITCHCAPVCC, 0x3C);
  
  // Startup flow:
  drawLogo();
  drawASTRASplash();
  drawSearching();
  
  // NRF24L01 initialization:
  radio.begin();
  radio.openReadingPipe(0, address);
  radio.setPALevel(RF24_PA_LOW);
  radio.setDataRate(RF24_250KBPS);
  radio.startListening();
  
  lastSignalTime = millis();
  lastRSSICheck = millis();
}

//---------------------------------------------------------------
// Main loop function
void loop() {
  // Check for incoming radio packets
  if (radio.available()) {
    // Read the packet into receivedPacket array
    radio.read(&receivedPacket, sizeof(receivedPacket));
    lastSignalTime = millis();
    packetsReceived++;

    // Assume the packet is in the format: "V:11.5,R:80,G:28.7041,77.1025"
    sscanf(receivedPacket, "V:%f,R:%d,G:%31[^\n]", &voltage, &rssi, gpsData);
  }
  
  // Calculate packet-loss based pseudo-RSSI every second
  if (millis() - lastRSSICheck >= 1000) {
    rssiPercent = (packetsReceived * 100) / expectedPacketsPerSecond;
    packetsReceived = 0;
    lastRSSICheck = millis();
  }
  
  // Check the push button to toggle GPS coordinate display
  if (digitalRead(BUTTON_PIN) == LOW) {
    showCoordinates = !showCoordinates;
    delay(300);  // simple debounce
  }
  
  // Now update the display:
  display.clearDisplay();
  
  // If no signal for more than signalTimeout, display searching screen:
  if (millis() - lastSignalTime > signalTimeout) {
    drawSearching();
  } else {
    // Display telemetry info when signal is active.
    display.setTextSize(1.5);
    display.setTextColor(WHITE);
    // First line: Battery Voltage
    display.setCursor(0, 0);
    display.print("Voltage: ");
    display.print(voltage, 1);
    display.println(" V");
    
    // Second line: Pseudo-RSSI from packet reception rate
    display.setCursor(0, 10);
    display.print("Signal: ");
    display.print(rssiPercent);
    display.println("%");
    
    // If toggled, show GPS coordinates; else prompt user to press button.
    if (showCoordinates) {
      display.setCursor(0, 25);
      display.print("Lat: ");
      display.println(gpsData); // Assuming gpsData holds latitude & longitude combined; 
                                // if separate, adjust accordingly.
    } else {
      display.setCursor(0, 25);
      display.println("Press Btn for GPS");
    }
    display.display();
  }
}